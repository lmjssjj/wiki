## android/android system/Kernel/kernel-4.9/drivers/misc/mediatek/nuu_read_info/Kconfig
```kconfig
config READ_HARDWARE_INFOMATION
  bool "READ_HARDWARE_INFOMATION Driver"
  default n
  help
    READ_HARDWARE_INFOMATION
```
